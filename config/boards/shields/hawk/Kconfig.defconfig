## config/boards/shields/hawk/Kconfig.defconfig
```kconfig
if HAWK_LEFT || HAWK_RIGHT

config ZMK_KEYBOARD_NAME
	default "Hawk"

config ZMK_SPLIT
	default y

config ZMK_BLE
	default y

if HAWK_LEFT

config ZMK_SPLIT_ROLE_CENTRAL
	default y

endif # SHIELD_HAWK_LEFT

endif # SHIELD_HAWK_LEFT || SHIELD_HAWK_RIGHT
```

## config/boards/shields/hawk/Kconfig.shield
```kconfig
config HAWK_LEFT
	def_bool $(shields_list_contains,hawk_left)

config HAWK_RIGHT
	def_bool $(shields_list_contains,hawk_right)
```

## config/boards/shields/supermini_split/Kconfig.defconfig
```kconfig
if SHIELD_SUPERMINI_SPLIT_LEFT || SHIELD_SUPERMINI_SPLIT_RIGHT

config ZMK_KEYBOARD_NAME
	default "Supermini Split"

config ZMK_SPLIT
	default y

config ZMK_BLE
	default y

if SHIELD_SUPERMINI_SPLIT_LEFT

config ZMK_SPLIT_ROLE_CENTRAL
	default y

endif # SHIELD_SUPERMINI_SPLIT_LEFT

endif # SHIELD_SUPERMINI_SPLIT_LEFT || SHIELD_SUPERMINI_SPLIT_RIGHT
```

## config/boards/shields/supermini_split/Kconfig.shield
```kconfig
config SHIELD_SUPERMINI_SPLIT_LEFT
	def_bool $(shields_list_contains,supermini_split_left)

config SHIELD_SUPERMINI_SPLIT_RIGHT
	def_bool $(shields_list_contains,supermini_split_right)
```

## config/west.yml
```yaml
manifest:
  remotes:
    - name: zmkfirmware
      url-base: https://github.com/zmkfirmware
      - name: robertwidfen
      url-base: https://github.com/robertwidfen/
  projects:
    - name: zmk
      remote: zmkfirmware
      revision: main
      import: app/west.yml
    - name: zmk-module-caps-word-de
      remote: robertwidfen
  self:
    path: config
```
