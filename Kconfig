## Kconfig
```kconfig
config HEARTBEAT_LED
    bool "RGB status indicator via onboard WS2812 NeoPixel"
    default n
    help
      Uses the Waveshare RP2040-Zero onboard WS2812 NeoPixel (GP16, aliased as
      'led-strip' in the board DTS) to show three distinct status colours:

        Blue  1 Hz blink  = board is powered and ZMK is running (heartbeat)
        Green 150 ms flash = key detected on THIS half (UART TX proxy)
        Red   150 ms flash = key received from the OTHER half (UART RX proxy)
                             Central (left) only: position col >= 6

      Requires CONFIG_LED_STRIP=y and the 'led-strip' DTS alias to be defined.
```

## config/boards/shields/handwired/Kconfig.defconfig
```kconfig
if SHIELD_HANDWIRED_LEFT

config ZMK_KEYBOARD_NAME
    default "Handwired"

endif

if SHIELD_HANDWIRED_RIGHT

config ZMK_KEYBOARD_NAME
    default "Handwired"

endif
```

## config/boards/shields/handwired/Kconfig.shield
```kconfig
config SHIELD_HANDWIRED_LEFT
    def_bool $(shields_list_contains,handwired_left)

config SHIELD_HANDWIRED_RIGHT
    def_bool $(shields_list_contains,handwired_right)
```

## config/dts/bindings/input/cirque,pinnacle.yaml
```yaml
# Falls die Datei noch nicht so anfängt:
description: "Cirque Pinnacle"
compatible: "cirque-pinnacle"

description: "Cirque Pinnacle Trackpad"
compatible: "cirque,pinnacle"
include: spi-device.yaml

properties:
  dr-gpios:
    type: phandle-array
    required: true
    description: "Data Ready Interrupt GPIO"
```

## config/zephyr/Kconfig
```kconfig
config INPUT_PINNACLE
    bool "Cirque Pinnacle"
    default y
    depends on SPI
```
